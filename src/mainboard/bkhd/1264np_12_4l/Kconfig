## src/mainboard/bkhd/1264np_12_4l/Kconfig
```kconfig
## SPDX-License-Identifier: GPL-2.0-or-later

if BOARD_BKHD_1264NP_12_4L

config BOARD_SPECIFIC_OPTIONS
	def_bool y
	select AZALIA_USE_LEGACY_VERB_TABLE
	select BOARD_ROMSIZE_KB_16384
	select SMBIOS_TYPE41_PROVIDED_BY_DEVTREE
	select DRIVERS_OPTION_CFR_ENABLED if PAYLOAD_EDK2 && SMMSTORE
	select FSP_TYPE_IOT
	select HAVE_ACPI_TABLES
	select HAVE_ACPI_RESUME
	select SUPERIO_ITE_IT8625E
	select DRIVERS_UART_8250IO
	select SOC_INTEL_ALDERLAKE_PCH_N
	select INTEL_GMA_HAVE_VBT
	select SOC_INTEL_COMMON_BLOCK_HDA_VERB
	select HAVE_INTEL_PTT
	select CRB_TPM
	select MAINBOARD_HAS_TPM2
	select MAINBOARD_HAS_LIBGFXINIT

config MAINBOARD_DIR
	default "bkhd/1264np_12_4l"

config INTEL_GMA_VBT_FILE
	default "src/mainboard/bkhd/1264np_12_4l/data.vbt"

config MAINBOARD_PART_NUMBER
	default "1264NP-12-4L"

config BEEP_ON_BOOT
	bool "Beep (ascending chime) on successful boot"
	default y
	help
	  Play a short ascending arpeggio over the front-panel piezo buzzer at
	  the end of ramstage to signal a successful boot (handy in headless
	  operation). The buzzer hangs off GPP_B14, which is the SATA activity
	  LED at runtime; the beep routine briefly muxes it to the SPKR native
	  function and restores it afterwards. This is the build-time default;
	  the beep can also be toggled at runtime via the "Boot beep" CFR option.

config CONSOLE_CBMEM_BUFFER_SIZE
	default 0x100000	# 1 MiB - headroom for the verbose boot log (and fbcon replay if enabled)

endif # BOARD_BKHD_1264NP_12_4L
```

## src/mainboard/bkhd/1264np_12_4l/Kconfig.name
```kconfig
## SPDX-License-Identifier: GPL-2.0-or-later

config BOARD_BKHD_1264NP_12_4L
	bool "1264NP-12-4L"
```

## src/mainboard/bkhd/Kconfig
```kconfig
## SPDX-License-Identifier: GPL-2.0-or-later

if VENDOR_BKHD

choice
	prompt "Mainboard model"

source "src/mainboard/bkhd/*/Kconfig.name"

endchoice

source "src/mainboard/bkhd/*/Kconfig"

config MAINBOARD_VENDOR
	default "BKHD"

endif # VENDOR_BKHD
```

## src/mainboard/gmktec/Kconfig
```kconfig
## SPDX-License-Identifier: GPL-2.0-only

if VENDOR_GMKTEC

choice
	prompt "Mainboard model"

source "src/mainboard/gmktec/*/Kconfig.name"

endchoice

source "src/mainboard/gmktec/*/Kconfig"

config MAINBOARD_VENDOR
	default "GMKtec"

endif # VENDOR_GMKTEC
```

## src/mainboard/gmktec/g10/Kconfig.name
```kconfig
## SPDX-License-Identifier: GPL-2.0-only

config BOARD_GMKTEC_G10
	bool "NucBox G10"
```
